## config/west.yml
```yaml
manifest:
  remotes:
    - name: zmkfirmware
      url-base: https://github.com/zmkfirmware
      
    - name: hitsmaxft
      url-base: https://github.com/hitsmaxft
      
    #- name: englmaxi
    #  url-base: https://github.com/englmaxi
      
    - name: urob
      url-base: https://github.com/urob
      
    - name: janpfischer
      url-base: https://github.com/janpfischer
      
    #- name: carrefinho
    #  url-base: https://github.com/carrefinho

    #- name: myprospector
    #  url-base: https://github.com/komai3
      
  projects:
    - name: zmk
      remote: zmkfirmware
      revision: main
      clone-depth: 1
      import:
        file: app/west.yml
        
    - name: zmk-helpers
      remote: urob
      revision: main
      clone-depth: 1

    # cornixのRBG LED（まだ未対応）
    #- name: zmk-rgbled-widget
    #  remote: hitsmaxft
    #  revision: main
    #  clone-depth: 1

    # Dongle Display運用の場合
    #- name: zmk-dongle-display
    #  remote: englmaxi
    #  revision: main
    #  clone-depth: 1
    #
    # YADS運用の場合  
    - name: zmk-dongle-screen
      remote: janpfischer
      revision: upgrade-4.1
      clone-depth: 1
    #
    # Prospector運用の場合
    #- name: prospector-zmk-module
    #  remote: carrefinho
    #  revision: feat/new-status-screens
    #  clone-depth: 1
    #
    # prospector運用（ローカル版）の場合
    #- name: prospector-zmk-module
    #  remote: myprospector
    #  revision: cornix-custom-classic
    #  clone-depth: 1
      
  self:
    path: config
```
